## conf/distro/rtosamp.conf
```bitbake
require conf/distro/poky.conf

DISTRO = "rtosamp"
DISTRO_NAME = "RtosAMP Distro"
DISTRO_VERSION = "1.0"
```

## conf/layer.conf
```bitbake
BBPATH .= ":${LAYERDIR}"
BBFILES += "${LAYERDIR}/recipes-*/*/*.bb \
           ${LAYERDIR}/recipes-*/*/*.bbappend"
BBFILE_COLLECTIONS += "rtosamp"
BBFILE_PRIORITY_rtosamp = "6"
BBFILE_PATTERN_rtosamp = "^${LAYERDIR}/"
```

## conf/machine/zynq-snickerdoodle.conf
```bitbake
require conf/machine/include/tune-zynq.inc
require conf/machine/include/machine-xilinx-default.inc
require conf/machine/include/machine-xilinx-board.inc

# I'm currently still using the u-boot provided by krtkl, but will
# go into building my own u-boot in the future
UBOOT_MACHINE = "zynq_zed_config"

SERIAL_CONSOLE = "115200 ttyPS0"

# Not sure what this does
KERNEL_EXTRA_ARGS_zynq-snickerdoodle = "UIMAGE_LOADADDR=0x3000000"

# You don't need the two kernel-module-* yet, but I have them in
# preparation for running an AMP configuration
MACHINE_ESSENTIAL_EXTRA_RDEPENDS += "libgcc \
                                     kernel-module-zynq-remoteproc \
                                     kernel-module-virtio-rpmsg-bus"

# Points to the device tree sources for this machine
MACHINE_DEVICETREE := " \
        zynq-snickerdoodle/zynq-snickerdoodle.dts \
        zynq-snickerdoodle/zynq-7000.dtsi \
        zynq-snickerdoodle/skeleton.dtsi \
        "

# This changes the recipe used for compiling the Linux kernel.
# I like using linux-xlnx-dev so I can point to a bleeding edge kernel.
# Otherwise, one of the versioned linux-xlnx_* recipes is used from
# meta-xilinx layer.
PREFERRED_PROVIDER_virtual/kernel = "linux-xlnx-dev"
SRCREV_pn-linux-xlnx-dev = "6c95d00b074163af1b0641309e95564ffb8d0ada"
```
